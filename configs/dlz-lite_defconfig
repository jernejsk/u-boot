## configs/dlz-lite_defconfig
```kconfig
CONFIG_ARM=y
CONFIG_ARCH_SUNXI=y
CONFIG_DEFAULT_DEVICE_TREE="sun50i-t507-dlz-lite"
CONFIG_SPL=y
CONFIG_DRAM_SUN50I_H616_DX_ODT=0x03030303
CONFIG_DRAM_SUN50I_H616_DX_DRI=0x0e0e0e0e
CONFIG_DRAM_SUN50I_H616_CA_DRI=0x1919
CONFIG_DRAM_SUN50I_H616_ODT_EN=0xffffaa99
CONFIG_DRAM_SUN50I_H616_TPR2=0x1
CONFIG_DRAM_SUN50I_H616_TPR6=0x33808f80
CONFIG_DRAM_SUN50I_H616_TPR10=0x402f8878
CONFIG_DRAM_SUN50I_H616_TPR11=0x1a18161C
CONFIG_DRAM_SUN50I_H616_TPR12=0x0b0a0a0b
CONFIG_MACH_SUN50I_H616=y
CONFIG_SUNXI_DRAM_H616_DDR4=y
CONFIG_DRAM_CLK=576
CONFIG_R_I2C_ENABLE=y
# CONFIG_SYS_MALLOC_CLEAR_ON_INIT is not set
CONFIG_SPL_I2C=y
CONFIG_SPL_SYS_I2C_LEGACY=y
CONFIG_SYS_I2C_MVTWSI=y
CONFIG_SYS_I2C_SLAVE=0x7f
CONFIG_SYS_I2C_SPEED=400000
CONFIG_PHY_REALTEK=y
CONFIG_SUN8I_EMAC=y
CONFIG_REGULATOR_AXP=y
CONFIG_AXP858_POWER=y
CONFIG_AXP_DCDC5_VOLT=1200
```

## configs/myb_yt507h_defconfig
```kconfig
CONFIG_ARM=y
CONFIG_ARCH_SUNXI=y
CONFIG_DEFAULT_DEVICE_TREE="sun50i-t507-myd-yt507h"
# CONFIG_OF_UPSTREAM is not set
CONFIG_SPL=y
CONFIG_DRAM_SUNXI_DX_ODT=0x08080808
CONFIG_DRAM_SUNXI_DX_DRI=0x0e0e0e0e
CONFIG_DRAM_SUNXI_CA_DRI=0x0e0e
CONFIG_DRAM_SUNXI_ODT_EN=0x7887bbbb
CONFIG_DRAM_SUNXI_TPR6=0x37808080
CONFIG_DRAM_SUNXI_TPR10=0x402f6633
CONFIG_DRAM_SUNXI_TPR11=0x272b2b27
CONFIG_DRAM_SUNXI_TPR12=0x09090909
CONFIG_DRAM_SUNXI_PHY_ADDR_MAP_1=y
CONFIG_MACH_SUN50I_H616=y
CONFIG_SUNXI_DRAM_H616_LPDDR4=y
CONFIG_DRAM_CLK=720
CONFIG_R_I2C_ENABLE=y
# CONFIG_SYS_MALLOC_CLEAR_ON_INIT is not set
CONFIG_SPL_I2C=y
CONFIG_SPL_SYS_I2C_LEGACY=y
CONFIG_SYS_I2C_MVTWSI=y
CONFIG_SYS_I2C_SLAVE=0x7f
CONFIG_SYS_I2C_SPEED=400000
CONFIG_PHY_MOTORCOMM=y
CONFIG_PHY_ETHERNET_ID=y
CONFIG_SUN8I_EMAC=y
CONFIG_REGULATOR_AXP=y
CONFIG_AXP858_POWER=y
CONFIG_AXP_DCDC5_VOLT=1100
```
